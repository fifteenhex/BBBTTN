## bbbttn.its
```
/dts-v1/;

/ {
	description = "BBB TTN gateway";
	#address-cells = <1>;

	images {
		kernel@1 {
			data = /incbin/("./build/linux/arch/arm/boot/zImage");
			type = "kernel";
			arch = "arm";
			os = "linux";
			compression = "none";
			load = <0x82000000>;
			entry = <0x82000000>;
			hash@1 {
				algo = "crc32";
			};
			hash@2 {
				algo = "sha1";
			};
		};
		fdt@1 {
			data = /incbin/("./build/linux/arch/arm/boot/dts/am335x-boneblack.dtb");
			type = "flat_dt";
			arch = "arm";
			load = <0x83000000>;
			compression = "none";
			hash@1 {
				algo = "crc32";
			};
			hash@2 {
				algo = "sha1";
			};
		};
		ramdisk@1 {
			data = /incbin/("./build/buildroot/output/images/rootfs.cpio.xz");
			type = "ramdisk";
			arch = "arm";
			os = "linux";
			load = <0x84000000>;
			compression = "none";
			hash@1 {
				algo = "crc32";
			};
			hash@2 {
				algo = "sha1";
			};
		};
	};

	configurations {
		default = "conf@1";
		conf@1 {
			kernel = "kernel@1";
			fdt = "fdt@1";
			ramdisk = "ramdisk@1";
		};
	};
};
```

## br2external/Config.in
```kconfig
config BR2_BBLWGW_GATEWAY_NAME
        string "name of this gateway"

config BR2_BBLWGW_MQTT_HOST
        string "hostname of mqtt broker"

source "$BR2_EXTERNAL_BBBLWGW_PATH/package/lora_gateway/Config.in"
source "$BR2_EXTERNAL_BBBLWGW_PATH/package/packet_forwarder/Config.in"
source "$BR2_EXTERNAL_BBBLWGW_PATH/package/gateway_conf/Config.in"
source "$BR2_EXTERNAL_BBBLWGW_PATH/package/pktfwdbr/Config.in"
source "$BR2_EXTERNAL_BBBLWGW_PATH/package/gwctrl/Config.in"
```

## br2external/package/gwctrl/Config.in
```kconfig
config BR2_PACKAGE_GWCTRL
	bool "gwctrl"
	select BR2_PACKAGE_GLIB_NETWORKING
	select BR2_PACKAGE_HOST_PKGCONF
```

## br2external/package/pktfwdbr/Config.in
```kconfig
config BR2_PACKAGE_PKTFWDBR
	bool "pktfwdbr"
	select BR2_PACKAGE_GLIB_NETWORKING
	select BR2_PACKAGE_HOST_PKGCONF
	select BR2_PACKAGE_MOSQUITTO
```
